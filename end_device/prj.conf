## CMakeLists.txt
```
#
# Copyright (c) 2020 Nordic Semiconductor ASA
#
# SPDX-License-Identifier: LicenseRef-Nordic-5-Clause
#
cmake_minimum_required(VERSION 3.13.1)

list(INSERT OVERLAY_CONFIG 0 ../common/overlay-ot-defaults.conf)

find_package(Zephyr REQUIRED HINTS $ENV{ZEPHYR_BASE})

project(openthread_cli)

target_sources(app PRIVATE src/main.c)

FILE(GLOB core_sources /src/*.c)
target_sources(app PRIVATE ${core_sources})
target_include_directories(app PRIVATE /src)
```

## prj.conf
```kconfig
#
# Copyright (c) 2020 Nordic Semiconductor
#
# SPDX-License-Identifier: LicenseRef-Nordic-5-Clause
#

# Logging
CONFIG_OT_COMMAND_LINE_INTERFACE_LOG_LEVEL_DBG=y
CONFIG_NET_CONFIG_LOG_LEVEL_INF=y

# Network shell
CONFIG_NET_SHELL=y
CONFIG_SHELL_ARGC_MAX=26
CONFIG_SHELL_CMD_BUFF_SIZE=416

# Enable OpenThread features set
CONFIG_OPENTHREAD_NORDIC_LIBRARY_MASTER=y
CONFIG_OPENTHREAD_MANUAL_START=y
```

## prj_nrf5340dk_nrf5340_cpuapp.conf
```kconfig
#
# Copyright (c) 2020 Nordic Semiconductor
#
# SPDX-License-Identifier: LicenseRef-Nordic-5-Clause
#

# Logging
CONFIG_OT_COMMAND_LINE_INTERFACE_LOG_LEVEL_DBG=y
CONFIG_NET_CONFIG_LOG_LEVEL_INF=y

# Network shell
CONFIG_NET_SHELL=y
CONFIG_SHELL_ARGC_MAX=26
CONFIG_SHELL_CMD_BUFF_SIZE=416

# Enable OpenThread features set
CONFIG_OPENTHREAD_NORDIC_LIBRARY_MASTER=y

# Default PRNG entropy for nRF53 Series devices is CSPRNG CC312
# which for that purpose is too slow yet
# Use Xoroshiro128+ as PRNG
CONFIG_XOROSHIRO_RANDOM_GENERATOR=y
CONFIG_OPENTHREAD_MANUAL_START=y
```

## src/main.c
```c
// /*
//  * Copyright (c) 2020 Nordic Semiconductor ASA
//  *
//  * SPDX-License-Identifier: LicenseRef-Nordic-5-Clause
//  */

#include <zephyr.h>
#include <logging/log.h>
#include <net/openthread.h>
#include <net/socket.h>
#include <net/mqtt.h>
#include <random/rand32.h>
#include <string.h>
#include <errno.h>

#if defined(CONFIG_NET_L2_OPENTHREAD)
static struct openthread_context *ot_context;
#endif

#define CHILD_TIMEOUT 5

static otDeviceRole role;

LOG_MODULE_REGISTER(cli_sample, CONFIG_OT_COMMAND_LINE_INTERFACE_LOG_LEVEL);

struct k_timer my_timer;

/* sending data to backend server every 2 seconds */
void timer_handler();

static void update_role(void)
{
	role = otThreadGetDeviceRole(ot_context->instance);
	printk("OT role: %u", role);

	/* Device connected */
	if (role != OT_DEVICE_ROLE_DISABLED && role != OT_DEVICE_ROLE_DETACHED)
		return;

	/* Device disconnected */
	printk("OT disconnected!");
}

static void change_cb(otChangedFlags aFlags, void *aContext)
{
	/* Ignore if no role change */
	if ((aFlags & OT_CHANGED_THREAD_ROLE) == false)
		return;

	printk("OT Role changed");
	update_role();
}

int ot_config_init(void)
{
	struct net_if *iface;

	/* Load interface and context */
	LOG_DBG("Initializing OpenThread handler");
	iface = net_if_get_default();
	if (iface == NULL) {
		printk("Failed to get net interface");
		return -1;
	}

	ot_context = net_if_l2_data(iface);
	if (ot_context == NULL) {
		printk("Failed to get OT context");
		return -1;
	}

	return 0;
}

int ot_config_stop(void)
{
	int rc;

	/* Disable OpenThread service */
	LOG_DBG("Stopping OpenThread service");

	rc = otThreadSetEnabled(ot_context->instance, false);
	if (rc) {
		LOG_ERR("Failed to stop Thread protocol. (err %d)", rc);
		return rc;
	}

	rc = otIp6SetEnabled(ot_context->instance, false);
	if (rc)
		LOG_ERR("Failed to disable IPv6 communication. (err %d)", rc);

	return rc;
}


// start the thread when join successfully
otJoinerCallback HandleJoinerCallback(otError aError, void *aContext) {

	// if (aError == OT_ERROR_NONE) {
	// 	printk("successful\n");
	// 	//set up thread
	// 	aError = otThreadSetEnabled(instance, true);
	// }
}

int ot_config_start(void)
{
	int rc;

	/* Enable OpenThread service */
	printk("Starting OpenThread service");

	rc = otIp6SetEnabled(ot_context->instance, true);
	if (rc) {
		printk("Failed to enable IPv6 communication. (err %d)", rc);
		return rc;
	}

	rc = otThreadSetEnabled(ot_context->instance, true);
	if (rc)
		printk("Failed to start Thread protocol. (err %d)", rc);

	return rc;
}

K_TIMER_DEFINE(my_timer,timer_handler,NULL);

void main(void)
{

	//initialising
	ot_config_init();

	otError error;
	error = otIp6SetEnabled(ot_context->instance, true);
	error = otThreadSetRouterEligible(ot_context->instance,false);

	k_timer_start(&my_timer, K_SECONDS(2), K_SECONDS(2));
}

void timer_handler() {
	// //check state of thread
	otDeviceRole role = otThreadGetDeviceRole(ot_context->instance);
	otRouterInfo parentInfo;
	otError error;
	
	// storing rssi value
	int8_t aParentRssi;

	// // all child will send to server
	if (role == OT_DEVICE_ROLE_CHILD) {
		//rssi
		if (otThreadGetParentInfo(ot_context->instance, &parentInfo) == OT_ERROR_NONE && parentInfo.mLinkEstablished == true) {
			error = otThreadGetParentAverageRssi(ot_context->instance,&aParentRssi);
			printk("here\n");
		}

	} 

}
```

## src/config.h
```c
/*
 * Copyright (c) 2017 Intel Corporation
 *
 * SPDX-License-Identifier: Apache-2.0
 */

#ifndef __CONFIG_H__
#define __CONFIG_H__

#ifdef CONFIG_NET_CONFIG_SETTINGS
#ifdef CONFIG_NET_IPV6
#define ZEPHYR_ADDR		CONFIG_NET_CONFIG_MY_IPV6_ADDR
#define SERVER_ADDR		CONFIG_NET_CONFIG_PEER_IPV6_ADDR
#else
#define ZEPHYR_ADDR		CONFIG_NET_CONFIG_MY_IPV4_ADDR
#define SERVER_ADDR		CONFIG_NET_CONFIG_PEER_IPV4_ADDR
#endif
#else
#ifdef CONFIG_NET_IPV6
#define ZEPHYR_ADDR		"2001:db8::1"
#define SERVER_ADDR		"2001:db8::2"
#else
#define ZEPHYR_ADDR		"192.168.1.101"
#define SERVER_ADDR		"192.168.1.10"
#endif
#endif

#if defined(CONFIG_SOCKS)
#define SOCKS5_PROXY_ADDR	SERVER_ADDR
#define SOCKS5_PROXY_PORT	1080
#endif

#ifdef CONFIG_MQTT_LIB_TLS
#ifdef CONFIG_MQTT_LIB_WEBSOCKET
#define SERVER_PORT		9001
#else
#define SERVER_PORT		8883
#endif /* CONFIG_MQTT_LIB_WEBSOCKET */
#else
#ifdef CONFIG_MQTT_LIB_WEBSOCKET
#define SERVER_PORT		9001
#else
#define SERVER_PORT		1883
#endif /* CONFIG_MQTT_LIB_WEBSOCKET */
#endif

#define APP_CONNECT_TIMEOUT_MS	2000
#define APP_SLEEP_MSECS		500

#define APP_CONNECT_TRIES	10

#define APP_MQTT_BUFFER_SIZE	128

#define MQTT_CLIENTID		"zephyr_publisher"

/* Set the following to 1 to enable the Bluemix topic format */
#define APP_BLUEMIX_TOPIC	0

/* These are the parameters for the Bluemix topic format */
#if APP_BLUEMIX_TOPIC
#define BLUEMIX_DEVTYPE		"sensor"
#define BLUEMIX_DEVID		"carbon"
#define BLUEMIX_EVENT		"status"
#define BLUEMIX_FORMAT		"json"
#endif

#endif

#define CONFIG_NET_SAMPLE_APP_MAX_CONNECTIONS 3
#define CONFIG_NET_SAMPLE_APP_MAX_ITERATIONS 3
```
